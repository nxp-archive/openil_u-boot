// SPDX-License-Identifier: GPL-2.0+ OR X11
/*
 * P2041RDB Device Tree Source
 *
 * Copyright 2011 - 2015 Freescale Semiconductor Inc.
 * Copyright 2019 NXP
 */

/include/ "p2041.dtsi"

/ {
	model = "fsl,P2041RDB";
	compatible = "fsl,P2041RDB";
	#address-cells = <2>;
	#size-cells = <2>;
	interrupt-parent = <&mpic>;

	aliases {
		spi0 = &espi0;
	};
};

&espi0 {
	status = "okay";
	flash@0 {
		compatible = "jedec,spi-nor";
		#address-cells = <1>;
		#size-cells = <1>;
		reg = <0>;
		spi-max-frequency = <10000000>; /* input clock */
	};
};
