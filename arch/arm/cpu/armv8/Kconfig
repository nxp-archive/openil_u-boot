## arch/arm/cpu/armv8/Kconfig
```kconfig
if ARM64

config ARMV8_MULTIENTRY
        bool "Enable multiple CPUs to enter into U-Boot"

config ARMV8_SET_SMPEN
        bool "Enable data coherency with other cores in cluster"
        help
          Cortex A53/57/72 cores require CPUECTLR_EL1.SMPEN set even
          for single core systems. Unfortunately write access to this
          register may be controlled by EL3/EL2 firmware. To be more
          precise, by default (if there is EL2/EL3 firmware running)
          this register is RO for NS EL1.
          This switch can be used to avoid writing to CPUECTLR_EL1,
          it can be safely enabled when El2/EL3 initialized SMPEN bit
          or when CPU implementation doesn't include that register.

config ARMV8_SPIN_TABLE
	bool "Support spin-table enable method"
	depends on ARMV8_MULTIENTRY && OF_LIBFDT
	help
	  Say Y here to support "spin-table" enable method for booting Linux.

	  To use this feature, you must do:
	    - Specify enable-method = "spin-table" in each CPU node in the
	      Device Tree you are using to boot the kernel
	    - Let secondary CPUs in U-Boot (in a board specific manner)
	      before the master CPU jumps to the kernel

	  U-Boot automatically does:
	    - Set "cpu-release-addr" property of each CPU node
	      (overwrites it if already exists).
	    - Reserve the code for the spin-table and the release address
	      via a /memreserve/ region in the Device Tree.

endif
```

## board/freescale/imx8mm_evk/Kconfig
```kconfig
if TARGET_IMX8MM_EVK || TARGET_IMX8MM_DDR4_EVK

config SYS_BOARD
	default "imx8mm_evk"

config SYS_VENDOR
	default "freescale"

config SYS_CONFIG_NAME
	default "imx8mm_evk"

config BAREMETAL
	bool "Enable baremetal"
	default n

source "board/freescale/common/Kconfig"

endif
```

## board/freescale/imx8mp_evk/Kconfig
```kconfig
if TARGET_IMX8MP_EVK

config SYS_BOARD
	default "imx8mp_evk"

config SYS_VENDOR
	default "freescale"

config SYS_CONFIG_NAME
	default "imx8mp_evk"

config BAREMETAL
	bool "Enable baremetal"
	default y

config NIC_COREID_SET
	bool "Enable NIC for baremetal"
	default n
	depends on BAREMETAL

config NIC_NIC0_COREID
	int "which core that NIC is assigned to"
	default "1"
	depends on NIC_COREID_SET

source "board/freescale/common/Kconfig"

endif
```

## board/freescale/ls1012afrdm/Kconfig
```kconfig
if TARGET_LS1012AFRDM

config SYS_BOARD
	default "ls1012afrdm"

config SYS_VENDOR
	default "freescale"

config SYS_SOC
	default "fsl-layerscape"

config SYS_CONFIG_NAME
	default "ls1012afrdm"

config SYS_LS_PFE_FW_ADDR
	hex "Flash address of PFE firmware"
	default 0x40a00000

config SYS_LS_PPA_FW_ADDR
	hex "PPA Firmware Addr"
	default 0x40400000

endif
```

## board/freescale/ls1012afrwy/Kconfig
```kconfig
if TARGET_LS1012AFRWY

config SYS_BOARD
	default "ls1012afrwy"

config SYS_VENDOR
	default "freescale"

config SYS_SOC
	default "fsl-layerscape"

config SYS_CONFIG_NAME
	default "ls1012afrwy"

config SYS_LS_PFE_FW_ADDR
	hex "Flash address of PFE firmware"
	default 0x40020000

config SYS_LS_PPA_FW_ADDR
	hex "PPA Firmware Addr"
	default 0x40060000

config SYS_LS_PPA_ESBC_ADDR
	hex "PPA Firmware HDR Addr"
	default 0x401f4000

config SYS_LS_PFE_ESBC_ADDR
	hex "PFE Firmware HDR Addr"
	default 0x401f8000

endif
```

## board/freescale/ls1012afrx/Kconfig
```kconfig
if FSL_PFE

config BOARD_SPECIFIC_OPTIONS # dummy
	def_bool y
	select PHYLIB
	imply PHY_REALTEK
	imply PHY_ATHEROS

config DDR_PFE_PHYS_BASEADDR
	hex "PFE DDR physical base address"
	default 0x03800000

config DDR_PFE_BASEADDR
	hex "PFE DDR base address"
	default 0x83800000

config PFE_EMAC1_PHY_ADDR
	hex "PFE DDR base address"
	default 0x2

config PFE_EMAC2_PHY_ADDR
	hex "PFE DDR base address"
	default 0x1

endif

source "board/freescale/common/Kconfig"
```

## board/freescale/ls1021aiot/Kconfig
```kconfig
if TARGET_LS1021AIOT

config SYS_BOARD
	default "ls1021aiot"

config SYS_VENDOR
	default "freescale"

config SYS_SOC
	default "ls102xa"

config SYS_CONFIG_NAME
	default "ls1021aiot"

choice
	prompt "Baremetal feature select"
	default BM_CAN
	depends on BAREMETAL
	help
	  For baremetal, GPIO3_15/27 and CAN3/4 has the same pins.
	  Therefore, we need to select the pins

config BM_CAN
	bool "Can3/4 supported"

config BM_GPIO
	bool "GPIO3_15/27 supported"

endchoice

source "board/freescale/common/Kconfig"

endif
```

## board/freescale/ls1028a/Kconfig
```kconfig
if TARGET_LS1028AQDS

config SYS_BOARD
	default "ls1028a"

config SYS_VENDOR
	default "freescale"

config SYS_SOC
	default "fsl-layerscape"

config SYS_CONFIG_NAME
	default "ls1028aqds"

config EMMC_BOOT
	bool "Support for booting from EMMC"
	default n

config SYS_TEXT_BASE
	default 0x96000000 if SD_BOOT || EMMC_BOOT
	default 0x82000000 if TFABOOT
	default 0x20100000

if FSL_LS_PPA
config SYS_LS_PPA_FW_ADDR
	hex "PPA Firmware Addr"
	default 0x20400000 if SYS_LS_PPA_FW_IN_XIP && ARCH_LS1028A
	default 0x400000 if SYS_LS_PPA_FW_IN_MMC && ARCH_LS1028A
if CHAIN_OF_TRUST
config SYS_LS_PPA_ESBC_ADDR
	hex "PPA header Addr"
	default 0x20600000 if SYS_LS_PPA_FW_IN_XIP && ARCH_LS1028A
endif
endif

source "board/freescale/common/Kconfig"

endif

if TARGET_LS1028ARDB

config SYS_BOARD
	default "ls1028a"

config SYS_VENDOR
	default "freescale"

config SYS_SOC
	default "fsl-layerscape"

config SYS_CONFIG_NAME
	default "ls1028ardb"

config EMMC_BOOT
	bool "Support for booting from EMMC"
	default n

config SYS_TEXT_BASE
	default 0x96000000 if SD_BOOT || EMMC_BOOT
	default 0x82000000 if TFABOOT
	default 0x20100000

config BAREMETAL
   bool "Enable baremetal"
   default y

config ENETC_COREID_SET
   bool "Enable ENETC for baremetal"
   default y
   depends on BAREMETAL

config ENETC_ENETC1_COREID
   int "Enetc1 is assigned to core1"
   default "1"
   depends on ENETC_COREID_SET

config ENETC_CTL_NUM
   int "ENETC controller numbers"
   default "1"
   depends on ENETC_COREID_SET

source "board/freescale/common/Kconfig"

endif
```

## board/freescale/ls1043aqds/Kconfig
```kconfig
if TARGET_LS1043AQDS

config SYS_BOARD
	default "ls1043aqds"

config SYS_VENDOR
	default "freescale"

config SYS_SOC
	default "fsl-layerscape"

config SYS_CONFIG_NAME
	default "ls1043aqds"

if SYS_LS_PPA_FW_IN_XIP

config SYS_LS_PPA_FW_ADDR
	hex "PPA Firmware Addr"
	default 0x60400000
endif

if (SYS_LS_PPA_FW_IN_XIP && QSPI_BOOT)

config SYS_LS_PPA_FW_ADDR
	hex "PPA Firmware Addr"
	default 0x40400000
endif

if (SYS_LS_PPA_FW_IN_MMC || SYS_LS_PPA_FW_IN_NAND)

config SYS_LS_PPA_FW_ADDR
	hex "PPA Firmware Addr"
	default 0x400000
endif

source "board/freescale/common/Kconfig"

endif
```

## board/freescale/ls1043ardb/Kconfig
```kconfig
if TARGET_LS1043ARDB

config SYS_BOARD
	default "ls1043ardb"

config SYS_VENDOR
	default "freescale"

config SYS_SOC
	default "fsl-layerscape"

config SYS_CONFIG_NAME
	default "ls1043ardb"

config SYS_HAS_ARMV8_SECURE_BASE
	bool "Enable secure address for PSCI image"
	depends on ARMV8_PSCI
	default n
	help
	  PSCI image can be re-located to secure RAM.
	  If enabled, please also define the value for ARMV8_SECURE_BASE,
	  for LS1043ARDB, it could be some address in OCRAM.

if FSL_LS_PPA
config SYS_LS_PPA_FW_ADDR
	hex "PPA Firmware Addr"
	default 0x60400000 if SYS_LS_PPA_FW_IN_XIP
	default 0x400000 if SYS_LS_PPA_FW_IN_MMC || SYS_LS_PPA_FW_IN_NAND

if CHAIN_OF_TRUST
config SYS_LS_PPA_ESBC_ADDR
	hex "PPA Firmware HDR Addr"
	default 0x60680000 if SYS_LS_PPA_FW_IN_XIP
	default 0x680000 if SYS_LS_PPA_FW_IN_MMC || SYS_LS_PPA_FW_IN_NAND
endif
endif

config BAREMETAL
	bool "Enable baremetal"
	default y

config FMAN_COREID_SET
	bool "Enable FMAN for baremetal"
	default n
	depends on BAREMETAL

config FMAN_FMAN1_COREID
	int "FMAN1 is assigned to that core"
	default "1"

config IFC_COREID_SET
	bool "Enable IFC for baremetal"
	default n
	depends on BAREMETAL

config IFC_COREID
	int "IFC is assigned to that core"
	default "1"
	depends on IFC_COREID_SET

config USB_COREID_SET
	bool "Enable USB for baremetal"
	default y
	depends on BAREMETAL

config USB_USB0_COREID
	int "USB0 is assigned to core1"
	default "1"
	depends on USB_COREID_SET

config USB_USB1_COREID
	int "USB1 is assigned to core2"
	default "2"
	depends on USB_COREID_SET

config USB_USB2_COREID
	int "USB2 is assigned to core3"
	default "3"
	depends on USB_COREID_SET

config USB_CTL_NUM
	int "USB Controller numbers "
	default "3"
	depends on USB_COREID_SET

config PCIE_COREID_SET
	bool "Enable PCIE for baremetal"
	default y
	depends on BAREMETAL

config PCIE_PCIE1_COREID
	int "PCIe1 is assigned to core0"
	default "0"
	depends on PCIE_COREID_SET

config PCIE_PCIE2_COREID
	int "PCIe2 is assigned to core1"
	default "1"
	depends on PCIE_COREID_SET

config PCIE_PCIE3_COREID
	int "PCIe3 is assigned to core2"
	default "2"
	depends on PCIE_COREID_SET

config PCIE_CTL_NUM
	int "PCIe Controller numbers "
	default "3"
	depends on PCIE_COREID_SET

source "board/freescale/common/Kconfig"

endif
```

## board/freescale/ls1046aqds/Kconfig
```kconfig
if TARGET_LS1046AQDS

config SYS_BOARD
	default "ls1046aqds"

config SYS_VENDOR
	default "freescale"

config SYS_SOC
	default "fsl-layerscape"

config SYS_CONFIG_NAME
	default "ls1046aqds"

if SYS_LS_PPA_FW_IN_XIP

config SYS_LS_PPA_FW_ADDR
	hex "PPA Firmware Addr"
	default 0x60400000
endif

if (SYS_LS_PPA_FW_IN_XIP && QSPI_BOOT)

config SYS_LS_PPA_FW_ADDR
	hex "PPA Firmware Addr"
	default 0x40400000
endif

if (SYS_LS_PPA_FW_IN_MMC || SYS_LS_PPA_FW_IN_NAND)

config SYS_LS_PPA_FW_ADDR
	hex "PPA Firmware Addr"
	default 0x400000
endif

source "board/freescale/common/Kconfig"

endif
```

## board/freescale/ls1046ardb/Kconfig
```kconfig
if TARGET_LS1046ARDB

config SYS_BOARD
	default "ls1046ardb"

config SYS_VENDOR
	default "freescale"

config SYS_SOC
	default "fsl-layerscape"

config SYS_CONFIG_NAME
	default "ls1046ardb"

config USB_COREID_SET
	bool "Enable USB for baremetal"
	default n

config USB_USB0_COREID
	int "USB0 is assigned to core1"
	default "1"
	depends on USB_COREID_SET

config USB_USB1_COREID
	int "USB1 is assigned to core2"
	default "2"
	depends on USB_COREID_SET

config USB_USB2_COREID
	int "USB2 is assigned to core3"
	default "3"
	depends on USB_COREID_SET

config USB_CTL_NUM
	int "USB Controller numbers "
	default "3"
	depends on USB_COREID_SET

if FSL_LS_PPA
config SYS_LS_PPA_FW_ADDR
	hex "PPA Firmware Addr"
	default 0x40400000 if SYS_LS_PPA_FW_IN_XIP && QSPI_BOOT
	default 0x400000 if SYS_LS_PPA_FW_IN_MMC || SYS_LS_PPA_FW_IN_NAND

if CHAIN_OF_TRUST
config SYS_LS_PPA_ESBC_ADDR
	hex "PPA Firmware HDR Addr"
	default 0x40680000 if SYS_LS_PPA_FW_IN_XIP && QSPI_BOOT
	default 0x680000 if SYS_LS_PPA_FW_IN_MMC || SYS_LS_PPA_FW_IN_NAND
endif
endif

source "board/freescale/common/Kconfig"
endif
```

## board/freescale/ls1088a/Kconfig
```kconfig
if TARGET_LS1088AQDS

config SYS_BOARD
	default "ls1088a"

config SYS_VENDOR
	default "freescale"

config SYS_SOC
	default "fsl-layerscape"

config SYS_CONFIG_NAME
	default "ls1088aqds"

if SYS_LS_PPA_FW_IN_XIP

config SYS_LS_PPA_FW_ADDR
	hex "PPA Firmware Addr"
	default 0x20400000

if CHAIN_OF_TRUST
config SYS_LS_PPA_ESBC_ADDR
	hex "PPA Firmware HDR Addr"
	default 0x20680000
endif
endif

if (SYS_LS_PPA_FW_IN_MMC || SYS_LS_PPA_FW_IN_NAND)

config SYS_LS_PPA_FW_ADDR
	hex "PPA Firmware Addr"
	default 0x400000

if CHAIN_OF_TRUST
config SYS_LS_PPA_ESBC_ADDR
	hex "PPA Firmware HDR Addr"
	default 0x680000
endif
endif

source "board/freescale/common/Kconfig"
endif

if TARGET_LS1088ARDB

config SYS_BOARD
	default "ls1088a"

config SYS_VENDOR
	default "freescale"

config SYS_SOC
	default "fsl-layerscape"

config SYS_CONFIG_NAME
	default "ls1088ardb"

if SYS_LS_PPA_FW_IN_XIP

config SYS_LS_PPA_FW_ADDR
	hex "PPA Firmware Addr"
	default 0x20400000

if CHAIN_OF_TRUST
config SYS_LS_PPA_ESBC_ADDR
	hex "PPA Firmware HDR Addr"
	default 0x20680000
endif
endif

if (SYS_LS_PPA_FW_IN_MMC || SYS_LS_PPA_FW_IN_NAND)

config SYS_LS_PPA_FW_ADDR
	hex "PPA Firmware Addr"
	default 0x400000

if CHAIN_OF_TRUST
config SYS_LS_PPA_ESBC_ADDR
	hex "PPA Firmware HDR Addr"
	default 0x680000
endif
endif

source "board/freescale/common/Kconfig"
endif
```

## board/freescale/ls2080aqds/Kconfig
```kconfig
if TARGET_LS2080AQDS

config SYS_BOARD
	default "ls2080aqds"

config SYS_VENDOR
	default "freescale"

config SYS_SOC
	default "fsl-layerscape"

config SYS_CONFIG_NAME
	default "ls2080aqds"

if SYS_LS_PPA_FW_IN_XIP

config SYS_LS_PPA_FW_ADDR
	hex "PPA Firmware Addr"
	default 0x580400000

if CHAIN_OF_TRUST
config SYS_LS_PPA_ESBC_ADDR
	hex "PPA Firmware HDR Addr"
	default 0x580680000
endif
endif

if (SYS_LS_PPA_FW_IN_XIP && QSPI_BOOT)

config SYS_LS_PPA_FW_ADDR
	hex "PPA Firmware Addr"
	default 0x20400000

if CHAIN_OF_TRUST
config SYS_LS_PPA_ESBC_ADDR
	hex "PPA Firmware HDR Addr"
	default 0x20680000
endif
endif

if (SYS_LS_PPA_FW_IN_MMC || SYS_LS_PPA_FW_IN_NAND)

config SYS_LS_PPA_FW_ADDR
	hex "PPA Firmware Addr"
	default 0x400000

if CHAIN_OF_TRUST
config SYS_LS_PPA_ESBC_ADDR
	hex "PPA Firmware HDR Addr"
	default 0x680000
endif
endif

source "board/freescale/common/Kconfig"

endif
```

## configs/ls1021aiot_baremetal_defconfig
```kconfig
CONFIG_ARM=y
CONFIG_TARGET_LS1021AIOT=y
CONFIG_SYS_TEXT_BASE=0x84000000
CONFIG_DEFAULT_DEVICE_TREE="ls1021a-iot-duart"
CONFIG_SYS_EXTRA_OPTIONS="SD_BOOT,SD_BOOT_QSPI"
CONFIG_BOARD_EARLY_INIT_F=y
CONFIG_SYS_MMCSD_RAW_MODE_U_BOOT_USE_SECTOR=y
CONFIG_SYS_MMCSD_RAW_MODE_U_BOOT_SECTOR=0xe8
CONFIG_CMD_GPT=y
CONFIG_CMD_FAT=y
CONFIG_CMD_USB=y
CONFIG_OF_CONTROL=y
CONFIG_DM=y
CONFIG_FSL_CAAM=y
CONFIG_SPI_FLASH=y
CONFIG_SF_DEFAULT_BUS=0
CONFIG_SPI_FLASH_ATMEL=y
CONFIG_SPI_FLASH_STMICRO=y
CONFIG_NETDEVICES=y
CONFIG_E1000=y
CONFIG_PCI=y
CONFIG_DM_PCI=y
CONFIG_DM_PCI_COMPAT=y
CONFIG_PCIE_LAYERSCAPE=y
CONFIG_SYS_NS16550=y
CONFIG_SPI=y
CONFIG_DM_SPI=y
CONFIG_FSL_QSPI=y
CONFIG_USB=y
CONFIG_DM_USB=y
CONFIG_USB_XHCI_HCD=y
CONFIG_USB_XHCI_DWC3=y
CONFIG_USB_STORAGE=y
CONFIG_GPIO_COREID_SET=y
CONFIG_GPIO_GPIO2_COREID=1
CONFIG_I2C_COREID_SET=y
CONFIG_SYS_I2C_MXC_I2C0_COREID=1
CONFIG_IRQ_COREID_SET=y
CONFIG_QSPI_COREID_SET=y
CONFIG_USB_COREID_SET=y
CONFIG_USB_USB0_COREID=1
CONFIG_USB_CTL_NUM=1
```

## configs/ls1021aiot_qspi_defconfig
```kconfig
CONFIG_ARM=y
CONFIG_TARGET_LS1021AIOT=y
CONFIG_DEFAULT_DEVICE_TREE="ls1021a-iot-duart"
CONFIG_FIT=y
CONFIG_FIT_VERBOSE=y
CONFIG_OF_BOARD_SETUP=y
CONFIG_OF_STDOUT_VIA_ALIAS=y
CONFIG_SYS_EXTRA_OPTIONS="QSPI_BOOT"
CONFIG_QSPI_BOOT=y
CONFIG_BOOTDELAY=3
CONFIG_HUSH_PARSER=y
CONFIG_OF_CONTROL=y
CONFIG_DM=y
CONFIG_SPI_FLASH=y
CONFIG_SPI_FLASH_ATMEL=y
CONFIG_SPI_FLASH_STMICRO=y
CONFIG_NETDEVICES=y
CONFIG_E1000=y
CONFIG_SYS_NS16550=y
CONFIG_DM_SPI=y
CONFIG_FSL_DSPI=y
CONFIG_FSL_QSPI=y
```

## configs/ls1028acfp_defconfig
```kconfig
CONFIG_ARM=y
CONFIG_TARGET_LS1028AQDS=y
CONFIG_FSL_LS_PPA=y
CONFIG_DEFAULT_DEVICE_TREE="fsl-ls1028a-qds"
# CONFIG_SYS_MALLOC_F is not set
CONFIG_FIT_VERBOSE=y
CONFIG_EMU=y
CONFIG_EMU_CFP=y
CONFIG_EMU_DDR=y
CONFIG_OF_BOARD_SETUP=y
CONFIG_OF_STDOUT_VIA_ALIAS=y
CONFIG_BOOTDELAY=-1
CONFIG_USE_BOOTARGS=y
CONFIG_BOOTARGS="console=ttyS0,115200 root=/dev/ram0 earlycon=uart8250,mmio,0x21c0500 ramdisk_size=0x2000000 default_hugepagesz=2m hugepagesz=2m hugepages=256"
CONFIG_CMD_GREPENV=y
CONFIG_CMD_GPT=y
# CONFIG_CMD_SETEXPR is not set
CONFIG_CMD_CACHE=y
CONFIG_OF_CONTROL=y
CONFIG_ENV_IS_NOWHERE=y
CONFIG_NET_RANDOM_ETHADDR=y
CONFIG_DM=y
CONFIG_SYS_NS16550=y
```
