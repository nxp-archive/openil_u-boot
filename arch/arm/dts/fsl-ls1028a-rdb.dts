/*
 * NXP ls1028a Simulator device tree source
 *
 * Copyright 2018-2019 NXP
 *
 * SPDX-License-Identifier:	GPL-2.0+
 */

/dts-v1/;

#include "fsl-ls1028a.dtsi"

/ {
	model = "NXP Layerscape 1028a RDB Board";
	compatible = "fsl,ls1028a-rdb", "fsl,ls1028a";
	aliases {
		spi0 = &fspi;
	};
};

&fspi {
	bus-num = <0>;
	status = "okay";

	qflash0: mt35xu512g@0 {
		#address-cells = <1>;
		#size-cells = <1>;
		compatible = "spi-flash";
		spi-max-frequency = <20000000>; /* TODO Need to chk*/
		reg = <0>;
	 };
};
