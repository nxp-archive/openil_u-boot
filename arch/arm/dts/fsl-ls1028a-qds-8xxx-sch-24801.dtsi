// SPDX-License-Identifier: GPL-2.0+ OR X11
/*
 * NXP ls1028AQDS device tree fragment for RCW 8xxx
 *
 * Copyright 2019 NXP
 *
 */

/*
 * This set-up is using SCH-24801 cards with VSC8234 quad SGMII PHY in slot 1.
 */

&slot1 {
	#include "fsl-sch-24801.dtsi"
};

&enetc0 {
	status = "okay";
	phy-mode = "sgmii";
	phy-handle = <&{/i2c@2000000/fpga@66/mux-mdio@54/mdio@40/phy@1c}>;
};
