// SPDX-License-Identifier: GPL-2.0+ OR X11
/*
 * NXP ls1028AQDS device tree fragment for RCW 7xx7
 *
 * Copyright 2019 NXP
 *
 */


&slot1 {
#include "fsl-sch-30841.dtsi"
};

&ethsw_ports {
	port@0 {
		status = "okay";
		phy-mode = "sgmii-2500";
		phy-handle = <&{/i2c@2000000/fpga@66/mux-mdio@54/mdio@40/phy@02}>;
	};
	port@3 {
		status = "okay";
		phy-mode = "sgmii-2500";
		phy-handle = <&{/i2c@2000000/fpga@66/mux-mdio@54/mdio@40/phy@03}>;
	};
};
